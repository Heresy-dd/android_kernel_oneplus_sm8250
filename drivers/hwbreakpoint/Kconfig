## drivers/hwbreakpoint/Kconfig
```kconfig
config HWBREAKPOINT_PROC
	tristate "Hardware Breakpoint Proc module"
	default m
	help
	  Hardware breakpoint debugging driver for ARM64.
```

## drivers/rwprocmem/Kconfig
```kconfig
config RWPROCMEM33
	tristate "rwProcMem33 kernel module"
	default m
	help
	  Process memory read/write driver for ARM64.
```
